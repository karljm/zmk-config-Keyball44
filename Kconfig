## dts/bindings/behaviors/zmk,behavior-edit-child-layer.yaml
```yaml
# Copyright (c) 2026
# SPDX-License-Identifier: MIT

description: Child layer latch while edit parent is held

compatible: "zmk,behavior-edit-child-layer"

include: one_param.yaml
```

## dts/bindings/behaviors/zmk,behavior-edit-parent.yaml
```yaml
# Copyright (c) 2026
# SPDX-License-Identifier: MIT

description: Parent-held edit layer behavior

compatible: "zmk,behavior-edit-parent"

include: one_param.yaml
```

#include <behaviors/mouse_keys.dtsi>
#include <behaviors.dtsi>
#include <dt-bindings/zmk/bt.h>
#include <dt-bindings/zmk/ext_power.h>
#include <dt-bindings/zmk/keys.h>
#include <dt-bindings/zmk/mouse.h>

#include <definitions/config.dtsi>

#include <features/custom_behaviors.dtsi>
#include <features/switcher.dtsi>

#include <config/combos.dtsi>
